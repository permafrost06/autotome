## boards/shields/autotome/Kconfig.defconfig
```kconfig
if SHIELD_AUTOTOME_LEFT

config ZMK_KEYBOARD_NAME
    default "autotome"

config ZMK_SPLIT_ROLE_CENTRAL
    default y

endif # SHIELD_AUTOTOME_LEFT

if SHIELD_AUTOTOME_LEFT || SHIELD_AUTOTOME_RIGHT

config ZMK_SPLIT
    default y

endif # SHIELD_AUTOTOME_LEFT || SHIELD_AUTOTOME_RIGHT
```

## boards/shields/autotome/Kconfig.shield
```kconfig
config SHIELD_AUTOTOME_LEFT
    def_bool $(shields_list_contains,autotome_left)

config SHIELD_AUTOTOME_RIGHT
    def_bool $(shields_list_contains,autotome_right)
```
