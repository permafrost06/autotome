#include <behaviors.dtsi>
#include <dt-bindings/zmk/keys.h>
#include <dt-bindings/zmk/pointing.h>
#include <dt-bindings/zmk/dynamic_macro.h>

#define CONFIG_WIRELESS

#ifdef CONFIG_WIRELESS
    #include <dt-bindings/zmk/bt.h>
    #define _BT_SEL_KEYS_ &bt BT_SEL 0 &bt BT_SEL 1 &bt BT_SEL 2 &bt BT_SEL 3 &bt BT_CLR
#else
    #define _BT_SEL_KEYS_ ___ ___ ___ ___ ___
#endif

#include "zmk-helpers/helper.h"

#define DEF 0
#define NUM 1
#define FN 2
#define SYS 3
#define SYM 4

#define ___ &trans

/* Global settings */

#define QUICK_TAP_MS 175

/* Homerow mods */

#define KEYS_L 0 1 2 3 4 5 12 13 14 15 16 17 24 25 26 27 28 29 30
#define KEYS_R 6 7 8 9 10 11 18 19 20 21 22 23 31 32 33 34 35 36 37
#define THUMBS 38 39 40 41

#define MAKE_HRM(NAME, HOLD, TAP, TRIGGER_POS) \
    ZMK_HOLD_TAP(NAME, \
        flavor = "balanced"; \
        tapping-term-ms = <280>; \
        quick-tap-ms = <QUICK_TAP_MS>; \
        require-prior-idle-ms = <150>; \
        bindings = <HOLD>, <TAP>; \
        hold-trigger-key-positions = <TRIGGER_POS>; \
        hold-trigger-on-release; \
    )
MAKE_HRM(hml, &kp, &kp, KEYS_R THUMBS)
MAKE_HRM(hmr, &kp, &kp, KEYS_L THUMBS)

&lt {
    quick-tap-ms = <QUICK_TAP_MS>;
};

&caps_word {
    /delete-property/ ignore-modifiers;
};

&msc {
    trigger-period-ms = <1>;
};

/ {
    macros {
        scroll_up: scroll_up {
            compatible = "zmk,behavior-macro";
            #binding-cells = <0>;
            bindings = <&macro_press &msc SCRL_UP>, <&macro_wait_time 20>, <&macro_release &msc SCRL_UP>;
        };

        scroll_down: scroll_down {
            compatible = "zmk,behavior-macro";
            #binding-cells = <0>;
            bindings = <&macro_press &msc SCRL_DOWN>, <&macro_wait_time 20>, <&macro_release &msc SCRL_DOWN>;
        };

        scroll_left: scroll_left {
            compatible = "zmk,behavior-macro";
            #binding-cells = <0>;
            bindings = <&macro_press &msc SCRL_LEFT>, <&macro_wait_time 20>, <&macro_release &msc SCRL_LEFT>;
        };

        scroll_right: scroll_right {
            compatible = "zmk,behavior-macro";
            #binding-cells = <0>;
            bindings = <&macro_press &msc SCRL_RIGHT>, <&macro_wait_time 20>, <&macro_release &msc SCRL_RIGHT>;
        };
    };

    behaviors {
        dm: dynmacro {
            compatible = "zmk,behavior-dynamic-macro";
            #binding-cells = <2>;
            display-name = "Dynamic Macro";
        };

        inc_dec_msc_y: enc_mouse_scroll_y {
            compatible = "zmk,behavior-sensor-rotate";
            #sensor-binding-cells = <0>;
            bindings = <&scroll_up>, <&scroll_down>;
        };

        inc_dec_msc_x: enc_mouse_scroll_x {
            compatible = "zmk,behavior-sensor-rotate";
            #sensor-binding-cells = <0>;
            bindings = <&scroll_left>, <&scroll_right>;
        };
    };
};

ZMK_CONDITIONAL_LAYER(sys, NUM FN, SYS)  // FN + NUM --> SYS

/* Keymap */

/ {
    keymap {
        compatible = "zmk,keymap";

        default_layer {
            display-name = "DEF";
            bindings = <
//╭────────────────┬────────────────┬────────────────┬────────────────┬────────────────┬────────────────╮                                   ╭────────────────┬────────────────┬────────────────┬────────────────┬────────────────┬────────────────╮
    &kp TAB          &kp Q            &kp W            &kp E            &kp R            &kp T                                                &kp Y            &kp U            &kp I            &kp O            &kp P            &kp MINUS
//├────────────────┼────────────────┼────────────────┼────────────────┼────────────────┼────────────────┤                                   ├────────────────┼────────────────┼────────────────┼────────────────┼────────────────┼────────────────┤
    &kp ESC          &hml LGUI A      &hml LALT S      &hml LSHFT D     &hml LCTRL F     &kp G                                                &kp H            &hmr RCTRL J     &hmr RSHFT K     &hmr RALT L      &hmr RGUI SEMI   &kp APOS
//├────────────────┼────────────────┼────────────────┼────────────────┼────────────────┼────────────────┼────────────────╮ ╭────────────────┼────────────────┼────────────────┼────────────────┼────────────────┼────────────────┼────────────────┤
    &mo SYM          &kp Z            &kp X            &kp C            &kp V            &kp B            &kp C_MUTE         &kp F13          &kp N            &kp M            &kp COMMA        &kp PERIOD       &kp FSLH         &kp EQUAL
//╰────────────────┴────────────────┴────────────────┴────────────────┼────────────────┼────────────────┼────────────────╯ ╰────────────────┼────────────────┴────────────────┴────────────────┴────────────────┴────────────────┴────────────────╯
                                                                        &lt NUM DEL      &kp SPACE                                            &kp RET          &lt FN BSPC
//                                                                    ╰────────────────┴────────────────╯                                   ╰────────────────┴────────────────╯
            >;

            sensor-bindings = <&inc_dec_kp C_VOL_UP C_VOL_DN>, <&inc_dec_kp C_BRI_DN C_BRI_UP>;
        };

        num_layer {
            display-name = "NUM";
            bindings = <
//╭────────────┬────────────┬────────────┬────────────┬────────────┬────────────╮                           ╭────────────┬────────────┬────────────┬────────────┬────────────┬────────────╮
    &kp GRAVE    &kp N1       &kp N2       &kp N3       &kp N4       &kp N5                                   &kp N6       &kp N7       &kp N8       &kp N9       &kp N0       &kp MINUS
//├────────────┼────────────┼────────────┼────────────┼────────────┼────────────┤                           ├────────────┼────────────┼────────────┼────────────┼────────────┼────────────┤
    ___          &dm DM_REC 0  &dm DM_STP 0 &caps_word   ___          ___                                      &kp LEFT     &kp DOWN     &kp UP       &kp RIGHT    &kp PSCRN    ___
//├────────────┼────────────┼────────────┼────────────┼────────────┼────────────┼────────────╮ ╭────────────┼────────────┼────────────┼────────────┼────────────┼────────────┼────────────┤
    ___          ___          ___          ___          ___          ___          ___            ___          &kp HOME     &kp PG_UP    &kp PG_DN    &kp END      &kp INS      &dm DM_PLY 0
//╰────────────┴────────────┴────────────┴────────────┼────────────┼────────────┼────────────╯ ╰────────────┼────────────┴────────────┴────────────┴────────────┴────────────┴────────────╯
                                                        ___          ___                                      ___          ___
//                                                    ╰────────────┴────────────╯                           ╰────────────┴────────────╯
            >;

            sensor-bindings = <&inc_dec_kp C_VOL_UP C_VOL_DN>, <&inc_dec_kp C_BRI_DN C_BRI_UP>;
        };

        fn_layer {
            display-name = "FN";
            bindings = <
//╭────────────┬────────────┬────────────┬────────────┬────────────┬────────────╮                           ╭────────────┬────────────┬────────────┬────────────┬────────────┬────────────╮
    ___          &kp F1       &kp F2       &kp F3       &kp F4       &kp F5                                   &kp F6       &kp F7       &kp F8       &kp F9       &kp F10      ___
//├────────────┼────────────┼────────────┼────────────┼────────────┼────────────┤                           ├────────────┼────────────┼────────────┼────────────┼────────────┼────────────┤
    ___          &dm DM_REC 0  &dm DM_STP 0 &caps_word   ___          ___                                      &kp LEFT     &kp DOWN     &kp UP       &kp RIGHT    &kp PSCRN    ___
//├────────────┼────────────┼────────────┼────────────┼────────────┼────────────┼────────────╮ ╭────────────┼────────────┼────────────┼────────────┼────────────┼────────────┼────────────┤
    ___          &kp F11      &kp F12      ___          ___          ___          &kp C_PP       ___          &kp HOME     &kp PG_UP    &kp PG_DN    &kp END      &kp INS      &dm DM_PLY 0
//╰────────────┴────────────┴────────────┴────────────┼────────────┼────────────┼────────────╯ ╰────────────┼────────────┴────────────┴────────────┴────────────┴────────────┴────────────╯
                                                        ___          ___                                      ___          ___
//                                                    ╰────────────┴────────────╯                           ╰────────────┴────────────╯
            >;

            sensor-bindings = <&inc_dec_kp RIGHT LEFT>, <&inc_dec_kp C_BRI_DN C_BRI_UP>;
        };

        sys_layer {
            display-name = "SYS";
            bindings = <
//╭────────────────┬────────────────┬────────────────┬────────────────┬────────────────┬────────────────╮                                   ╭────────────────┬────────────────┬────────────────┬────────────────┬────────────────┬────────────────╮
                                        _BT_SEL_KEYS_                                    &studio_unlock                                       ___              ___              ___              ___              ___              ___
//├────────────────┼────────────────┼────────────────┼────────────────┼────────────────┼────────────────┤                                   ├────────────────┼────────────────┼────────────────┼────────────────┼────────────────┼────────────────┤
    ___              ___              ___              ___              ___              &bootloader                                          &bootloader      ___              ___              ___              ___              ___
//├────────────────┼────────────────┼────────────────┼────────────────┼────────────────┼────────────────┼────────────────╮ ╭────────────────┼────────────────┼────────────────┼────────────────┼────────────────┼────────────────┼────────────────┤
    ___              ___              ___              ___              ___              &sys_reset       ___                ___              &sys_reset       ___              ___              ___              ___              ___
//╰────────────────┴────────────────┴────────────────┴────────────────┼────────────────┼────────────────┼────────────────╯ ╰────────────────┼────────────────┴────────────────┴────────────────┴────────────────┴────────────────┴────────────────╯
                                                                        ___              ___                                                  ___              ___
//                                                                    ╰────────────────┴────────────────╯                                   ╰────────────────┴────────────────╯
            >;

            sensor-bindings = <&inc_dec_kp C_VOL_UP C_VOL_DN>, <&inc_dec_kp C_BRI_DN C_BRI_UP>;
        };

        sym_layer {
            display-name = "SYM";
            bindings = <
//╭────────────┬────────────┬────────────┬────────────┬────────────┬────────────╮                           ╭────────────┬────────────┬────────────┬────────────┬────────────┬────────────╮
    &kp TILDE    &kp EXCL     &kp AT       &kp HASH     &kp DLLR     &kp PRCNT                                &kp CARET    &kp AMPS     &kp ASTRK    &kp LPAR     &kp RPAR     &kp MINUS
//├────────────┼────────────┼────────────┼────────────┼────────────┼────────────┤                           ├────────────┼────────────┼────────────┼────────────┼────────────┼────────────┤
    ___          ___          ___          &caps_word   ___          ___                                      &kp BSLH     &kp LBRC     &kp RBRC     &kp LBKT     &kp RBKT     ___
//├────────────┼────────────┼────────────┼────────────┼────────────┼────────────┼────────────╮ ╭────────────┼────────────┼────────────┼────────────┼────────────┼────────────┼────────────┤
    ___          ___          ___          ___          ___          ___          ___            ___          ___          ___          ___          ___          ___          ___
//╰────────────┴────────────┴────────────┴────────────┼────────────┼────────────┼────────────╯ ╰────────────┼────────────┴────────────┴────────────┴────────────┴────────────┴────────────╯
                                                        ___          ___                                      ___          ___
//                                                    ╰────────────┴────────────╯                           ╰────────────┴────────────╯
            >;

            sensor-bindings = <&inc_dec_kp C_VOL_UP C_VOL_DN>, <&inc_dec_kp C_BRI_DN C_BRI_UP>;
        };
    };
};

/* vim: set ft=c tw=174: */
