## dynamic-macro/Kconfig
```kconfig
# Copyright (c) 2026 The ZMK Contributors
# SPDX-License-Identifier: MIT

config ZMK_BEHAVIOR_DYNAMIC_MACRO
    bool
    default y
    depends on DT_HAS_ZMK_BEHAVIOR_DYNAMIC_MACRO_ENABLED

if ZMK_BEHAVIOR_DYNAMIC_MACRO

config ZMK_BEHAVIOR_DYNAMIC_MACRO_TAP_DELAY
    int "Dynamic macro tap delay between events (ms)"
    default 30

config ZMK_BEHAVIOR_DYNAMIC_MACRO_MAX_SLOTS
    int "Dynamic macro max slots"
    default 1

config ZMK_BEHAVIOR_DYNAMIC_MACRO_MAX_EVENTS
    int "Dynamic macro max stored events"
    default 32

endif
```
